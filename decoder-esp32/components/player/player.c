#include <inttypes.h>
#include <string.h>
#include "freertos/FreeRTOS.h"
#include "freertos/task.h"
#include "pins.h"
#include "esp_check.h"
#include "esp_log.h"

#include "driver/i2s_pdm.h"
#include "driver/gpio.h"

#include "player.h"
#include "audio.h"
#include "slot.h"
#include "vm.h"
#include "variables.h"
#include "schedule.h"
#include "logger.h"

#define TAG "PLAYER"

#define PDM_TX_CLK_IO           I2S_BCLK_IO1      // I2S PDM TX clock io number
#define PDM_TX_DOUT_IO          I2S_DOUT_IO1      // I2S PDM TX data out io number

static i2s_chan_handle_t tx_chan;

/* Limited by DMA buffer size=2046 */
#define BUFFER_SIZE 2000
static uint16_t buffer[BUFFER_SIZE];


static void player_mixer_task(void *args)
{
    while (true) {
        uint16_t len = 0;
        mixer_fill_buffer(buffer, BUFFER_SIZE, &len);
        if (len) {
            if (i2s_channel_write(tx_chan, buffer, len * sizeof(uint16_t), NULL, 1000) != ESP_OK) {
                logger_printf("Player task: i2s write failed\n");
            }
        }
        vTaskDelay(pdMS_TO_TICKS(10));
    }
}

void player_init(void)
{
    if (!wave_get_samplerate()) {
        logger_printf("Project was not initialized, skipping player initialization");
        return;
    } else {
        logger_printf("Initializing player with samplerate %d", wave_get_samplerate());
    }
    /* I2S */
    i2s_chan_config_t tx_chan_cfg = I2S_CHANNEL_DEFAULT_CONFIG(I2S_NUM_AUTO, I2S_ROLE_MASTER);
    tx_chan_cfg.auto_clear = true;
    tx_chan_cfg.dma_desc_num = 4;
    tx_chan_cfg.dma_frame_num = BUFFER_SIZE;
    ESP_ERROR_CHECK(i2s_new_channel(&tx_chan_cfg, &tx_chan, NULL));

    /* Step 2: Setting the configurations of PDM TX mode and initialize the TX channel
     * The slot configuration and clock configuration can be generated by the macros
     * These two helper macros is defined in 'i2s_pdm.h' which can only be used in PDM TX mode.
     * They can help to specify the slot and clock configurations for initialization or re-configuring */
    i2s_pdm_tx_config_t pdm_tx_cfg = {
        .clk_cfg = I2S_PDM_TX_CLK_DEFAULT_CONFIG(wave_get_samplerate()),
        /* The data bit-width of PDM mode is fixed to 16 */
        .slot_cfg = I2S_PDM_TX_SLOT_DEFAULT_CONFIG(I2S_DATA_BIT_WIDTH_16BIT, I2S_SLOT_MODE_MONO),
        .gpio_cfg = {
            .clk = PDM_TX_CLK_IO,
            .dout = PDM_TX_DOUT_IO,
            .invert_flags = {
                .clk_inv = false,
            },
        },
    };
    ESP_ERROR_CHECK(i2s_channel_init_pdm_tx_mode(tx_chan, &pdm_tx_cfg));

    /* Step 3: Enable the tx channel before writing data */
    ESP_ERROR_CHECK(i2s_channel_enable(tx_chan));

    xTaskCreatePinnedToCore(player_mixer_task, "player_task", 2560, 0, 5, NULL, 1);
}
