## esp32/components/player/Kconfig.projbuild
```kconfig
menu "Example Configuration"

    config AUDIO_SAMPLE_RATE
        int "The audio sample rate (Unit: Hz)"
        default 31250
        help
            The audio sample rate

endmenu
```

## esp32/components/storage/Kconfig.projbuild
```kconfig
menu "Storage Configuration"

    choice STORAGE_BACKEND
        prompt "Storage backend"
        default STORAGE_SD if IDF_TARGET_ESP32
        default STORAGE_FLASH if IDF_TARGET_ESP32S3
        help
            Use internal flash or SD for sound project storage

        config STORAGE_SD
            bool "Store files on SD"
            help
                Use SD for sound project.

        config STORAGE_FLASH
            bool "Store files in internal flash"
            help
                Use internal flash for sound project.
    endchoice

    if STORAGE_SD
        config SD_PIN_MOSI
            int "MOSI GPIO number"
            default 15 if IDF_TARGET_ESP32
            default 35 if IDF_TARGET_ESP32S2
            default 4 if IDF_TARGET_ESP32S3
            default 5  if IDF_TARGET_ESP32H2
            default 36 if IDF_TARGET_ESP32P4
            default 4  # C3 and others

        config SD_PIN_MISO
            int "MISO GPIO number"
            default 2 if IDF_TARGET_ESP32
            default 37 if IDF_TARGET_ESP32S2
            default 5 if IDF_TARGET_ESP32S3
            default 0  if IDF_TARGET_ESP32H2
            default 47 if IDF_TARGET_ESP32P4
            default 6  # C3 and others

        config SD_PIN_CLK
            int "CLK GPIO number"
            default 14 if IDF_TARGET_ESP32
            default 36 if IDF_TARGET_ESP32S2
            default 2 if IDF_TARGET_ESP32S3
            default 4  if IDF_TARGET_ESP32H2
            default 53 if IDF_TARGET_ESP32P4
            default 5  # C3 and others

        config SD_PIN_CS
            int "CS GPIO number"
            default 13 if IDF_TARGET_ESP32
            default 34 if IDF_TARGET_ESP32S2
            default 8 if IDF_TARGET_ESP32S3
            default 33 if IDF_TARGET_ESP32P4
            default 1  # C3 and others
    endif
endmenu
```
