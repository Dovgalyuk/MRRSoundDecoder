## esp32/components/wifi/Kconfig.projbuild
```kconfig
menu "WiFi AP/Client Configuration"

    config WIFI_ON_DECODER
        bool "Enables client connection"
        default y
        help
            Flag to enable client connection to command station.

    config WIFI_LOC_SSID
        string "WiFi SSID"
        depends on WIFI_ON_DECODER
        default "train"
        help
            SSID (network name) for the example to connect to.

    config WIFI_LOC_PASSWORD
        string "WiFi Password"
        depends on WIFI_ON_DECODER
        default "12345678"
        help
            WiFi password (WPA or WPA2) for the example to use.

    config WIFI_CS_SSID
        string "WiFi SSID"
        default "trains"
        help
            SSID (network name).

    config WIFI_CS_PASSWORD
        string "WiFi Password"
        default "2204201425032020"
        help
            WiFi password (WPA or WPA2) to use.

    config WIFI_CHANNEL
        int "WiFi Channel"
        range 1 13
        default 1
        help
            WiFi channel (network channel) for the example to use.

    config MAX_STA_CONN
        int "Maximal STA connections"
        default 4
        range 1 15
        help
            Max number of the STA connects to AP.

    config GTK_REKEYING_ENABLE
        bool "Enable GTK Rekeying"
        default y
        help
            Flag to enable GTK rekeying.

    config GTK_REKEY_INTERVAL
        int "GTK rekey interval"
        depends on GTK_REKEYING_ENABLE
        range 60 65535
        default 600
        help
            GTK rekeying interval in seconds.
endmenu
```

## esp32/decoder/main/Kconfig.projbuild
```kconfig
menu "Main board configuration"

    config MOUNT_POINT
        string "Storage mount point"
        default "/decoder"
        help
            Mount point for project storage media

    config BOARD_VERSION
        int "Board version"
        default 1 if ESPTOOLPY_FLASHSIZE_4MB
        default 1 if ESPTOOLPY_FLASHSIZE_16MB
        default 2 if ESPTOOLPY_FLASHSIZE_32MB
        range 1 3
        help
            Version of the board with ESP32 WROOM
            3 - version with DRV8235
endmenu
```
